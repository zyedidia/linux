## arch/um/configs/nvme_defconfig
```kconfig
# UML kernel-only device runner: no userspace, NVMe over VFIO passthrough.
# See CONFIG_UML_NO_USERSPACE in arch/um/Kconfig.
# CONFIG_LOCALVERSION_AUTO is not set
# CONFIG_CROSS_MEMORY_ATTACH is not set
CONFIG_LOG_BUF_SHIFT=14
CONFIG_CC_OPTIMIZE_FOR_SIZE=y
CONFIG_EXPERT=y
# CONFIG_MULTIUSER is not set
# CONFIG_FUTEX is not set
# CONFIG_EPOLL is not set
# CONFIG_SIGNALFD is not set
# CONFIG_TIMERFD is not set
# CONFIG_EVENTFD is not set
# CONFIG_SHMEM is not set
# CONFIG_AIO is not set
# CONFIG_IO_URING is not set
CONFIG_UML_NO_USERSPACE=y
# CONFIG_STDERR_CONSOLE is not set
CONFIG_CON_CHAN="none"
CONFIG_UML_PCI_OVER_VFIO=y
# CONFIG_SUSPEND is not set
# CONFIG_SECCOMP is not set
# CONFIG_VMAP_STACK is not set
# CONFIG_BLOCK_LEGACY_AUTOLOAD is not set
# CONFIG_BLK_DEV_WRITE_MOUNTED is not set
# CONFIG_MQ_IOSCHED_DEADLINE is not set
# CONFIG_MQ_IOSCHED_KYBER is not set
# CONFIG_BINFMT_ELF is not set
# CONFIG_BINFMT_SCRIPT is not set
# CONFIG_COREDUMP is not set
# CONFIG_SWAP is not set
# CONFIG_SLAB_MERGE_DEFAULT is not set
# CONFIG_COMPAT_BRK is not set
# CONFIG_COMPACTION is not set
# CONFIG_PCIEASPM is not set
# CONFIG_VGA_ARB is not set
# CONFIG_STANDALONE is not set
# CONFIG_PREVENT_FIRMWARE_BUILD is not set
# CONFIG_BLK_DEV is not set
CONFIG_BLK_DEV_NVME=y
# CONFIG_INPUT_KEYBOARD is not set
# CONFIG_INPUT_MOUSE is not set
# CONFIG_SERIO is not set
# CONFIG_LEGACY_PTYS is not set
# CONFIG_LEGACY_TIOCSTI is not set
# CONFIG_LDISC_AUTOLOAD is not set
# CONFIG_HW_RANDOM is not set
# CONFIG_DEVMEM is not set
# CONFIG_HID_SUPPORT is not set
# CONFIG_VIRTIO_MENU is not set
# CONFIG_VHOST_MENU is not set
# CONFIG_IOMMU_SUPPORT is not set
# CONFIG_DNOTIFY is not set
# CONFIG_INOTIFY_USER is not set
# CONFIG_PROC_FS is not set
# CONFIG_SYSFS is not set
# CONFIG_MISC_FILESYSTEMS is not set
CONFIG_PRINTK_TIME=y
# CONFIG_SYMBOLIC_ERRNAME is not set
CONFIG_FRAME_WARN=1280
# CONFIG_SECTION_MISMATCH_WARN_ONLY is not set
CONFIG_DEBUG_MEMORY_INIT=y
# CONFIG_FTRACE is not set
# CONFIG_RUNTIME_TESTING_MENU is not set
```

## arch/x86/um/Kconfig
```kconfig
# SPDX-License-Identifier: GPL-2.0

menu "Host processor type and features"

source "arch/x86/Kconfig.cpu"

endmenu

config UML_X86
	def_bool y
	select ARCH_HAS_KERNEL_FPU_SUPPORT if 64BIT
	select ARCH_USE_QUEUED_RWLOCKS
	select ARCH_SUPPORTS_ATOMIC_RMW
	select ARCH_USE_QUEUED_SPINLOCKS
	select DCACHE_WORD_ACCESS
	select HAVE_EFFICIENT_UNALIGNED_ACCESS
	select UML_SUBARCH_SUPPORTS_SMP if X86_CX8

config 64BIT
	bool "64-bit kernel" if "$(SUBARCH)" = "x86"
	default "$(SUBARCH)" != "i386"

config X86_32
	def_bool !64BIT
	select ARCH_32BIT_OFF_T
	select ARCH_WANT_IPC_PARSE_VERSION
	select MODULES_USE_ELF_REL
	select CLONE_BACKWARDS
	select OLD_SIGSUSPEND3
	select OLD_SIGACTION

config X86_64
	def_bool 64BIT
	select MODULES_USE_ELF_RELA

config UML_LARGE_CODE_MODEL
	bool "Build the kernel with the large code model"
	depends on 64BIT
	help
	  The kernel is linked at 0x60000000 and normally built with the
	  small code model, which needs the whole image, including its bss,
	  to end below 2 GB. That leaves room for about 512 MB. Say Y if
	  linking the kernel fails with "relocation truncated to fit" errors,
	  as it can with allyesconfig.

	  If unsure, say N.

config ARCH_HAS_SC_SIGNALS
	def_bool !64BIT

config GENERIC_HWEIGHT
	def_bool y
```

## drivers/net/wireless/virtual/Kconfig
```kconfig
config MAC80211_HWSIM
	tristate "Simulated radio testing tool for mac80211"
	depends on MAC80211
	help
	  This driver is a developer testing tool that can be used to test
	  IEEE 802.11 networking stack (mac80211) functionality. This is not
	  needed for normal wireless LAN usage and is only for testing. See
	  Documentation/networking/mac80211_hwsim for more information on how
	  to use this tool.

	  To compile this driver as a module, choose M here: the module will be
	  called mac80211_hwsim.  If unsure, say N.

config VIRT_WIFI
	tristate "Wifi wrapper for ethernet drivers"
	depends on CFG80211
	help
	  This option adds support for ethernet connections to appear as if they
	  are wifi connections through a special rtnetlink device.

config VIRTIO_WLAN
	tristate "Virtio WLAN driver"
	depends on VIRTIO && CFG80211
	help
	  This option adds support for a virtio WLAN device, which implements
	  association on the device side and exchanges 802.3 frames with this
	  driver. It appears as an ordinary cfg80211 station interface, so the
	  usual wireless tools and supplicants work unchanged.

	  To compile this driver as a module, choose M here: the module will be
	  called virtio_wlan. If unsure, say N.
```

## drivers/vduse/Kconfig
```kconfig
# SPDX-License-Identifier: GPL-2.0-only
config VDUSE_GUEST
	bool
	select VHOST_RING
	help
	  The guest side of a VDUSE device: a transport that serves the
	  virtqueues of a VDUSE device on the host, and backends that
	  implement device types. A host, such as UML, selects this and
	  gives the transport its access to VDUSE.

config VDUSE_GUEST_BLK
	bool "VDUSE virtio-blk backend"
	depends on VDUSE_GUEST && BLOCK
	default y
	help
	  Export a block device of the guest to the host as a virtio-blk
	  device.

config VDUSE_GUEST_WLAN
	bool "VDUSE virtio-wlan backend"
	depends on VDUSE_GUEST && CFG80211=y && CFG80211_CLIENT
	default y
	help
	  Export a station interface of the guest to the host as a
	  virtio-wlan device. The backend drives the interface through
	  cfg80211's in-kernel client API. The interface must belong to a
	  mac80211 driver, which reports the BSS with a connection result
	  and reports a requested disconnection before the request returns.

config VDUSE_GUEST_NET
	bool "VDUSE virtio-net backend"
	depends on VDUSE_GUEST && NET
	default y
	help
	  Export an Ethernet interface of the guest to the host as a
	  virtio-net device. While the host's driver runs the device, every
	  frame that the interface receives goes to the host, and the
	  guest's own stack does not see it.

config VDUSE_GUEST_PCI
	bool "VDUSE devices through a VMM's VDUSE proxy"
	depends on PCI_MSI && 64BIT && !UML
	select VDUSE_GUEST
	help
	  Serve a VDUSE device on the host from a VM, through the VDUSE
	  proxy PCI device of InvirtIO's fork of Cloud Hypervisor. Devices
	  are given with vduse_guest.device=.
```
